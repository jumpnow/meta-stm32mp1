## conf/layer.conf
```bitbake
# We have a conf and classes directory, append to BBPATH
BBPATH .= ":${LAYERDIR}"

# We have a recipes directory, add to BBFILES
BBFILES += "${LAYERDIR}/recipes*/*/*.bb ${LAYERDIR}/recipes*/*/*.bbappend ${LAYERDIR}/images/*.bb"

BBFILE_COLLECTIONS += "meta-stm32mp1"
BBFILE_PATTERN_meta-stm32mp1 := "^${LAYERDIR}/"
BBFILE_PRIORITY_meta-stm32mp1 = "16"

LAYERSERIES_COMPAT_meta-stm32mp1 = "nanbield"
```
