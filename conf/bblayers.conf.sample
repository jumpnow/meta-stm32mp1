## conf/bblayers.conf.sample
```bitbake
# POKY_BBLAYERS_CONF_VERSION is increased each time build/conf/bblayers.conf
# changes incompatibly
POKY_BBLAYERS_CONF_VERSION = "2"

BBPATH = "${TOPDIR}"
BBFILES ?= ""

BBLAYERS ?= " \
  ${HOME}/poky-scarthgap/meta \
  ${HOME}/poky-scarthgap/meta-poky \
  ${HOME}/poky-scarthgap/meta-openembedded/meta-oe \
  ${HOME}/poky-scarthgap/meta-openembedded/meta-networking \
  ${HOME}/poky-scarthgap/meta-openembedded/meta-perl \
  ${HOME}/poky-scarthgap/meta-openembedded/meta-python \
  ${HOME}/poky-scarthgap/meta-security \
  ${HOME}/poky-scarthgap/meta-st-stm32mp \
  ${HOME}/poky-scarthgap/meta-qt6 \
  ${HOME}/stm32mp1/meta-stm32mp1 \
"
```

## conf/local.conf.sample
```bitbake
# Local configuration for meta-stm32mp1 images
# Yocto Project 5.2 Poky distribution [walnascar] branch

GLIBC_GENERATE_LOCALES = "en_US.UTF-8"

DISTRO_FEATURES = "ext2 opengl security systemd usbhost ${DISTRO_FEATURES_LIBC}"

DISTRO_FEATURES_BACKFILL_CONSIDERED += "pulseaudio sysvinit"

DISTRO_FEATURES:remove = "ptest"

INIT_MANAGER = "systemd"

MACHINE = "stm32mp1"

PREFERRED_PROVIDER_virtual/kernel = "linux-stm32mp"

IMAGE_ROOTFS_MAXSIZE = "3145728"
IMAGE_ROOTFS_SIZE = "3145728"

#DL_DIR = "/src/walnascar"
#SSTATE_DIR = "/oe5/stm32mp1/sstate-cache"
#TMPDIR = "/oe5/stm32mp1/tmp"

DISTRO = "poky"
PACKAGE_CLASSES = "package_ipk"

SDKMACHINE = "x86_64"

EXTRA_IMAGE_FEATURES = "empty-root-password allow-empty-password allow-root-login"

PATCHRESOLVE = "noop"
RM_OLD_IMAGE = "1"
INHERIT += "rm_work"
CONF_VERSION = "2"
```
